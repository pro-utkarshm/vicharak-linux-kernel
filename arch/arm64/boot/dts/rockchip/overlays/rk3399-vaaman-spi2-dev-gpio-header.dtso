// SPDX-License-Identifier: GPL-2.0+
// Copyright (C) 2025 Vicharak Computers Pvt. Ltd.

/dts-v1/;
/plugin/;

&{/} {
	metadata {
		title = "Enable SPI 2 dev on 40-Pin GPIO Header";
		compatible = "vicharak,rk3399-vaaman", "rockchip,rk3399";
		category = "misc";
		exclusive = "spi2", "GPIO2_B1", "GPIO2_B2", "GPIO2_B3", "GPIO2_B4";
		description = "Enables SPI 2 dev on Vicharak Vaaman\nNote: Max-frequency default at 30Mhz";
	};
};

&spi2 {
	status = "okay";
	#address-cells = <1>;
	#size-cells = <0>;

	spi_dev@0 {
		compatible = "rockchip,spidev";
		reg = <0>;
		spi-max-frequency = <30000000>;
	};
};
